RAM_SIZE = 128M;

UART0_ORIGIN = 0x10000000;
UART0_LENGTH = 0x100;
UART0_END = UART0_ORIGIN + UART0_LENGTH;

BOOT_ORIGIN   = 0x80000000;
BOOT_LENGTH   = 16K;
BOOT_END      = BOOT_ORIGIN + BOOT_LENGTH;

KERNEL_ORIGIN = BOOT_ORIGIN + BOOT_LENGTH;
KERNEL_LENGTH = RAM_SIZE - BOOT_LENGTH;
KERNEL_END    = KERNEL_ORIGIN + KERNEL_LENGTH;

SECTIONS
{
    _uart0_start = UART0_ORIGIN;
    _uart0_end = UART0_END;

    _boot_origin = BOOT_ORIGIN;
    _boot_end = BOOT_END;

    _kernel_origin = KERNEL_ORIGIN;
    _kernel_end = KERNEL_END;
}